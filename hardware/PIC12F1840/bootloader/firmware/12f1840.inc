; =====================================
;		Banks Definitions
; =====================================
BANK0			EQU	000h
BANK1			EQU	001h
BANK2			EQU	002h
BANK3			EQU	003h
BANK4			EQU	004h
BANK5			EQU	005h
BANK6			EQU	006h
BANK7			EQU	007h
BANK8			EQU	008h
BANK9			EQU	009h
BANK10			EQU	00Ah
BANK11			EQU	00Bh
BANK12			EQU	00Ch
BANK13			EQU	00Dh
BANK14			EQU	00Eh
BANK15			EQU	00Fh
BANK16			EQU	010h
BANK17			EQU	011h
BANK18			EQU	012h
BANK19			EQU	013h
BANK20			EQU	014h
BANK21			EQU	015h
BANK22			EQU	016h
BANK23			EQU	017h
BANK24			EQU	018h
BANK25			EQU	019h
BANK26			EQU	01Ah
BANK27			EQU	01Bh
BANK28			EQU	01Ch
BANK29			EQU	01Dh
BANK30			EQU	01Eh
BANK31			EQU	01Fh

; =====================================
;		SFR Definitions
; =====================================
INDF0			EQU	(0000h & 07Fh)	; BANK0
INDF1			EQU	(0001h & 07Fh)	; BANK0
PCL				EQU	(0002h & 07Fh)	; BANK0
STATUS			EQU	(0003h & 07Fh)	; BANK0
FSR0L			EQU	(0004h & 07Fh)	; BANK0
FSR0H			EQU	(0005h & 07Fh)	; BANK0
FSR1L			EQU	(0006h & 07Fh)	; BANK0
FSR1H			EQU	(0007h & 07Fh)	; BANK0
BSR				EQU	(0008h & 07Fh)	; BANK0
WREG			EQU	(0009h & 07Fh)	; BANK0
PCLATH			EQU	(000Ah & 07Fh)	; BANK0
INTCON			EQU	(000Bh & 07Fh)	; BANK0
PORTA			EQU	(000Ch & 07Fh)	; BANK0
PIR1			EQU	(0011h & 07Fh)	; BANK0
PIR2			EQU	(0012h & 07Fh)	; BANK0
TMR0			EQU	(0015h & 07Fh)	; BANK0
TMR1L			EQU	(0016h & 07Fh)	; BANK0
TMR1H			EQU	(0017h & 07Fh)	; BANK0
T1CON			EQU	(0018h & 07Fh)	; BANK0
T1GCON			EQU	(0019h & 07Fh)	; BANK0
TMR2			EQU	(001Ah & 07Fh)	; BANK0
PR2				EQU	(001Bh & 07Fh)	; BANK0
T2CON			EQU	(001Ch & 07Fh)	; BANK0
CPSCON0			EQU	(001Eh & 07Fh)	; BANK0
CPSCON1			EQU	(001Fh & 07Fh)	; BANK0
; =====================================
TRISA			EQU	(008Ch & 07Fh)	; BANK1
PIE1			EQU	(0091h & 07Fh)	; BANK1
PIE2			EQU	(0092h & 07Fh)	; BANK1
OPTION_REG		EQU	(0095h & 07Fh)	; BANK1
PCON			EQU	(0096h & 07Fh)	; BANK1
WDTCON			EQU	(0097h & 07Fh)	; BANK1
OSCTUNE			EQU	(0098h & 07Fh)	; BANK1
OSCCON			EQU	(0099h & 07Fh)	; BANK1
OSCSTAT			EQU	(009Ah & 07Fh)	; BANK1
ADRESL			EQU	(009Bh & 07Fh)	; BANK1
ADRESH			EQU	(009Ch & 07Fh)	; BANK1
ADCON0			EQU	(009Dh & 07Fh)	; BANK1
ADCON1			EQU	(009Eh & 07Fh)	; BANK1
; =====================================
LATA			EQU	(010Ch & 07Fh)	; BANK2
CM1CON0			EQU	(0111h & 07Fh)	; BANK2
CM1CON1			EQU	(0112h & 07Fh)	; BANK2
CMOUT			EQU	(0115h & 07Fh)	; BANK2
BORCON			EQU	(0116h & 07Fh)	; BANK2
FVRCON			EQU	(0117h & 07Fh)	; BANK2
DACCON0			EQU	(0118h & 07Fh)	; BANK2
DACCON1			EQU	(0119h & 07Fh)	; BANK2
SRCON0			EQU	(011Ah & 07Fh)	; BANK2
SRCON1			EQU	(011Bh & 07Fh)	; BANK2
APFCON			EQU	(011Dh & 07Fh)	; BANK2
APFCON0			EQU	(011Dh & 07Fh)	; BANK2
; =====================================
ANSELA			EQU	(018Ch & 07Fh)	; BANK3
EEADRL			EQU	(0191h & 07Fh)	; BANK3
EEADRH			EQU	(0192h & 07Fh)	; BANK3
EEDATL			EQU	(0193h & 07Fh)	; BANK3
EEDATA			EQU	(0193h & 07Fh)	; BANK3
EEDATH			EQU	(0194h & 07Fh)	; BANK3
EECON1			EQU	(0195h & 07Fh)	; BANK3
EECON2			EQU	(0196h & 07Fh)	; BANK3
VREGCON			EQU	(0197h & 07Fh)	; BANK3
RCREG			EQU	(0199h & 07Fh)	; BANK3
TXREG			EQU	(019Ah & 07Fh)	; BANK3
SPBRGL			EQU	(019Bh & 07Fh)	; BANK3
SPBRG			EQU	(019Bh & 07Fh)	; BANK3
SPBRGH			EQU	(019Ch & 07Fh)	; BANK3
RCSTA			EQU	(019Dh & 07Fh)	; BANK3
TXSTA			EQU	(019Eh & 07Fh)	; BANK3
BAUDCON			EQU	(019Fh & 07Fh)	; BANK3
; =====================================
WPUA			EQU	(020Ch & 07Fh)	; BANK4
SSP1BUF			EQU	(0211h & 07Fh)	; BANK4
SSPBUF			EQU	(0211h & 07Fh)	; BANK4
SSP1ADD			EQU	(0212h & 07Fh)	; BANK4
SSPADD			EQU	(0212h & 07Fh)	; BANK4
SSP1MSK			EQU	(0213h & 07Fh)	; BANK4
SSPMSK			EQU	(0213h & 07Fh)	; BANK4
SSP1STAT		EQU	(0214h & 07Fh)	; BANK4
SSPSTAT			EQU	(0214h & 07Fh)	; BANK4
SSP1CON1		EQU	(0215h & 07Fh)	; BANK4
SSPCON1			EQU	(0215h & 07Fh)	; BANK4
SSPCON			EQU	(0215h & 07Fh)	; BANK4
SSP1CON2		EQU	(0216h & 07Fh)	; BANK4
SSPCON2			EQU	(0216h & 07Fh)	; BANK4
SSP1CON3		EQU	(0217h & 07Fh)	; BANK4
SSPCON3			EQU	(0217h & 07Fh)	; BANK4
; =====================================
CCPR1L			EQU	(0291h & 07Fh)	; BANK5
CCPR1H			EQU	(0292h & 07Fh)	; BANK5
CCP1CON			EQU	(0293h & 07Fh)	; BANK5
PWM1CON			EQU	(0294h & 07Fh)	; BANK5
CCP1AS			EQU	(0295h & 07Fh)	; BANK5
ECCP1AS			EQU	(0295h & 07Fh)	; BANK5
PSTR1CON		EQU	(0296h & 07Fh)	; BANK5
; =====================================
IOCAP			EQU	(0391h & 07Fh)	; BANK7
IOCAN			EQU	(0392h & 07Fh)	; BANK7
IOCAF			EQU	(0393h & 07Fh)	; BANK7
CLKRCON			EQU	(039Ah & 07Fh)	; BANK7
MDCON			EQU	(039Ch & 07Fh)	; BANK7
MDSRC			EQU	(039Dh & 07Fh)	; BANK7
MDCARL			EQU	(039Eh & 07Fh)	; BANK7
MDCARH			EQU	(039Fh & 07Fh)	; BANK7
; =====================================
STATUS_SHAD		EQU	(0FE4h & 07Fh)	; BANK31
WREG_SHAD		EQU	(0FE5h & 07Fh)	; BANK31
BSR_SHAD		EQU	(0FE6h & 07Fh)	; BANK31
PCLATH_SHAD		EQU	(0FE7h & 07Fh)	; BANK31
FSR0L_SHAD		EQU	(0FE8h & 07Fh)	; BANK31
FSR0H_SHAD		EQU	(0FE9h & 07Fh)	; BANK31
FSR1L_SHAD		EQU	(0FEAh & 07Fh)	; BANK31
FSR1H_SHAD		EQU	(0FEBh & 07Fh)	; BANK31
STKPTR			EQU	(0FEDh & 07Fh)	; BANK31
TOSL			EQU	(0FEEh & 07Fh)	; BANK31
TOSH			EQU	(0FEFh & 07Fh)	; BANK31

; =====================================
;		SFR's Bits Definitions
; =====================================
CARRY			EQU	0	; STATUS
DC				EQU	1	; STATUS
ZERO			EQU	2	; STATUS
nPD				EQU	3	; STATUS
nTO				EQU	4	; STATUS
; =====================================
BSR0			EQU	0	; BSR
BSR1			EQU	1	; BSR
BSR2			EQU	2	; BSR
BSR3			EQU	3	; BSR
BSR4			EQU	4	; BSR
; =====================================
IOCIF			EQU	0	; INTCON
INTF			EQU	1	; INTCON
TMR0IF			EQU	2	; INTCON
IOCIE			EQU	3	; INTCON
INTE			EQU	4	; INTCON
TMR0IE			EQU	5	; INTCON
PEIE			EQU	6	; INTCON
GIE				EQU	7	; INTCON
T0IF			EQU	2	; INTCON
T0IE			EQU	5	; INTCON
; =====================================
RA0				EQU	0	; PORTA
RA1				EQU	1	; PORTA
RA2				EQU	2	; PORTA
RA3				EQU	3	; PORTA
RA4				EQU	4	; PORTA
RA5				EQU	5	; PORTA
; =====================================
TMR1IF			EQU	0	; PIR1
TMR2IF			EQU	1	; PIR1
CCP1IF			EQU	2	; PIR1
SSP1IF			EQU	3	; PIR1
TXIF			EQU	4	; PIR1
RCIF			EQU	5	; PIR1
ADIF			EQU	6	; PIR1
TMR1GIF			EQU	7	; PIR1
; =====================================
BCL1IF			EQU	3	; PIR2
EEIF			EQU	4	; PIR2
C1IF			EQU	5	; PIR2
OSFIF			EQU	7	; PIR2
; =====================================
TMR1ON			EQU	0	; T1CON
nT1SYNC			EQU	2	; T1CON
T1OSCEN			EQU	3	; T1CON
T1CKPS0			EQU	4	; T1CON
T1CKPS1			EQU	5	; T1CON
TMR1CS0			EQU	6	; T1CON
TMR1CS1			EQU	7	; T1CON
; =====================================
T1GSS0			EQU	0	; T1GCON
T1GSS1			EQU	1	; T1GCON
T1GVAL			EQU	2	; T1GCON
T1GGO			EQU	3	; T1GCON
T1GSPM			EQU	4	; T1GCON
T1GTM			EQU	5	; T1GCON
T1GPOL			EQU	6	; T1GCON
TMR1GE			EQU	7	; T1GCON
; =====================================
T2CKPS0			EQU	0	; T2CON
T2CKPS1			EQU	1	; T2CON
TMR2ON			EQU	2	; T2CON
T2OUTPS0		EQU	3	; T2CON
T2OUTPS1		EQU	4	; T2CON
T2OUTPS2		EQU	5	; T2CON
T2OUTPS3		EQU	6	; T2CON
; =====================================
T0XCS			EQU	0	; CPSCON0
CPSOUT			EQU	1	; CPSCON0
CPSRNG0			EQU	2	; CPSCON0
CPSRNG1			EQU	3	; CPSCON0
CPSON			EQU	7	; CPSCON0
; =====================================
CPSCH0			EQU	0	; CPSCON1
CPSCH1			EQU	1	; CPSCON1
; =====================================
TRIS_REGA0		EQU	0	; TRISA
TRIS_REGA1		EQU	1	; TRISA
TRIS_REGA2		EQU	2	; TRISA
TRIS_REGA3		EQU	3	; TRISA
TRIS_REGA4		EQU	4	; TRISA
TRIS_REGA5		EQU	5	; TRISA
; =====================================
TMR1IE			EQU	0	; PIE1
TMR2IE			EQU	1	; PIE1
CCP1IE			EQU	2	; PIE1
SSP1IE			EQU	3	; PIE1
TXIE			EQU	4	; PIE1
RCIE			EQU	5	; PIE1
ADIE			EQU	6	; PIE1
TMR1GIE			EQU	7	; PIE1
; =====================================
BCL1IE			EQU	3	; PIE2
EEIE			EQU	4	; PIE2
C1IE			EQU	5	; PIE2
OSFIE			EQU	7	; PIE2
; =====================================
PS0				EQU	0	; OPTION_REG
PS1				EQU	1	; OPTION_REG
PS2				EQU	2	; OPTION_REG
PSA				EQU	3	; OPTION_REG
TMR0SE			EQU	4	; OPTION_REG
TMR0CS			EQU	5	; OPTION_REG
INTEDG			EQU	6	; OPTION_REG
nWPUEN			EQU	7	; OPTION_REG
T0SE			EQU	4	; OPTION_REG
T0CS			EQU	5	; OPTION_REG
; =====================================
nBOR			EQU	0	; PCON
nPOR			EQU	1	; PCON
nRI				EQU	2	; PCON
nRMCLR			EQU	3	; PCON
STKUNF			EQU	6	; PCON
STKOVF			EQU	7	; PCON
; =====================================
SWDTEN			EQU	0	; WDTCON
WDTPS0			EQU	1	; WDTCON
WDTPS1			EQU	2	; WDTCON
WDTPS2			EQU	3	; WDTCON
WDTPS3			EQU	4	; WDTCON
WDTPS4			EQU	5	; WDTCON
; =====================================
TUN0			EQU	0	; OSCTUNE
TUN1			EQU	1	; OSCTUNE
TUN2			EQU	2	; OSCTUNE
TUN3			EQU	3	; OSCTUNE
TUN4			EQU	4	; OSCTUNE
TUN5			EQU	5	; OSCTUNE
; =====================================
SCS0			EQU	0	; OSCCON
SCS1			EQU	1	; OSCCON
IRCF0			EQU	3	; OSCCON
IRCF1			EQU	4	; OSCCON
IRCF2			EQU	5	; OSCCON
IRCF3			EQU	6	; OSCCON
SPLLEN			EQU	7	; OSCCON
; =====================================
HFIOFS			EQU	0	; OSCSTAT
LFIOFR			EQU	1	; OSCSTAT
MFIOFR			EQU	2	; OSCSTAT
HFIOFL			EQU	3	; OSCSTAT
HFIOFR			EQU	4	; OSCSTAT
OSTS			EQU	5	; OSCSTAT
PLLR			EQU	6	; OSCSTAT
T1OSCR			EQU	7	; OSCSTAT
; =====================================
ADON			EQU	0	; ADCON0
GO_nDONE		EQU	1	; ADCON0
CHS0			EQU	2	; ADCON0
CHS1			EQU	3	; ADCON0
CHS2			EQU	4	; ADCON0
CHS3			EQU	5	; ADCON0
CHS4			EQU	6	; ADCON0
ADGO			EQU	1	; ADCON0
; =====================================
ADPREF0			EQU	0	; ADCON1
ADPREF1			EQU	1	; ADCON1
ADCS0			EQU	4	; ADCON1
ADCS1			EQU	5	; ADCON1
ADCS2			EQU	6	; ADCON1
ADFM			EQU	7	; ADCON1
; =====================================
LATA0			EQU	0	; LATA
LATA1			EQU	1	; LATA
LATA2			EQU	2	; LATA
LATA4			EQU	4	; LATA
LATA5			EQU	5	; LATA
; =====================================
C1SYNC			EQU	0	; CM1CON0
C1HYS			EQU	1	; CM1CON0
C1SP			EQU	2	; CM1CON0
C1POL			EQU	4	; CM1CON0
C1OE			EQU	5	; CM1CON0
C1OUT			EQU	6	; CM1CON0
C1ON			EQU	7	; CM1CON0
; =====================================
C1NCH0			EQU	0	; CM1CON1
C1PCH0			EQU	4	; CM1CON1
C1PCH1			EQU	5	; CM1CON1
C1INTN			EQU	6	; CM1CON1
C1INTP			EQU	7	; CM1CON1
; =====================================
MC1OUT			EQU	0	; CMOUT
; =====================================
BORRDY			EQU	0	; BORCON
SBOREN			EQU	7	; BORCON
; =====================================
ADFVR0			EQU	0	; FVRCON
ADFVR1			EQU	1	; FVRCON
CDAFVR0			EQU	2	; FVRCON
CDAFVR1			EQU	3	; FVRCON
FVRRDY			EQU	6	; FVRCON
FVREN			EQU	7	; FVRCON
; =====================================
DACPSS0			EQU	2	; DACCON0
DACPSS1			EQU	3	; DACCON0
DACOE			EQU	5	; DACCON0
DACLPS			EQU	6	; DACCON0
DACEN			EQU	7	; DACCON0
; =====================================
DACR0			EQU	0	; DACCON1
DACR1			EQU	1	; DACCON1
DACR2			EQU	2	; DACCON1
DACR3			EQU	3	; DACCON1
DACR4			EQU	4	; DACCON1
; =====================================
SRPR			EQU	0	; SRCON0
SRPS			EQU	1	; SRCON0
SRNQEN			EQU	2	; SRCON0
SRQEN			EQU	3	; SRCON0
SRCLK0			EQU	4	; SRCON0
SRCLK1			EQU	5	; SRCON0
SRCLK2			EQU	6	; SRCON0
SRLEN			EQU	7	; SRCON0
; =====================================
SRRC1E			EQU	0	; SRCON1
SRRCKE			EQU	2	; SRCON1
SRRPE			EQU	3	; SRCON1
SRSC1E			EQU	4	; SRCON1
SRSCKE			EQU	6	; SRCON1
SRSPE			EQU	7	; SRCON1
; =====================================
CCP1SEL			EQU	0	; APFCON
P1BSEL			EQU	1	; APFCON
TXCKSEL			EQU	2	; APFCON
T1GSEL			EQU	3	; APFCON
SS1SEL			EQU	5	; APFCON
SDO1SEL			EQU	6	; APFCON
RXDTSEL			EQU	7	; APFCON
; =====================================
ANSA0			EQU	0	; ANSELA
ANSA1			EQU	1	; ANSELA
ANSA2			EQU	2	; ANSELA
ANSA4			EQU	4	; ANSELA
; =====================================
RD				EQU	0	; EECON1
WR				EQU	1	; EECON1
WREN			EQU	2	; EECON1
WRERR			EQU	3	; EECON1
FREE			EQU	4	; EECON1
LWLO			EQU	5	; EECON1
CFGS			EQU	6	; EECON1
EEPGD			EQU	7	; EECON1
; =====================================
VREGPM0			EQU	0	; VREGCON
VREGPM1			EQU	1	; VREGCON
; =====================================
RX9D			EQU	0	; RCSTA
OERR			EQU	1	; RCSTA
FERR			EQU	2	; RCSTA
ADDEN			EQU	3	; RCSTA
CREN			EQU	4	; RCSTA
SREN			EQU	5	; RCSTA
RX9				EQU	6	; RCSTA
SPEN			EQU	7	; RCSTA
; =====================================
TX9D			EQU	0	; TXSTA
TRMT			EQU	1	; TXSTA
BRGH			EQU	2	; TXSTA
SENDB			EQU	3	; TXSTA
SYNC			EQU	4	; TXSTA
TXEN			EQU	5	; TXSTA
TX9				EQU	6	; TXSTA
CSRC			EQU	7	; TXSTA
; =====================================
ABDEN			EQU	0	; BAUDCON
WUE				EQU	1	; BAUDCON
BRG16			EQU	3	; BAUDCON
SCKP			EQU	4	; BAUDCON
RCIDL			EQU	6	; BAUDCON
ABDOVF			EQU	7	; BAUDCON
; =====================================
WPUA0			EQU	0	; WPUA
WPUA1			EQU	1	; WPUA
WPUA2			EQU	2	; WPUA
WPUA3			EQU	3	; WPUA
WPUA4			EQU	4	; WPUA
WPUA5			EQU	5	; WPUA
; =====================================
BF				EQU	0	; SSP1STAT
UA				EQU	1	; SSP1STAT
R_nW			EQU	2	; SSP1STAT
S				EQU	3	; SSP1STAT
P				EQU	4	; SSP1STAT
D_nA			EQU	5	; SSP1STAT
CKE				EQU	6	; SSP1STAT
SMP				EQU	7	; SSP1STAT
; =====================================
SSPM0			EQU	0	; SSP1CON1
SSPM1			EQU	1	; SSP1CON1
SSPM2			EQU	2	; SSP1CON1
SSPM3			EQU	3	; SSP1CON1
CKP				EQU	4	; SSP1CON1
SSPEN			EQU	5	; SSP1CON1
SSPOV			EQU	6	; SSP1CON1
WCOL			EQU	7	; SSP1CON1
; =====================================
SEN				EQU	0	; SSP1CON2
RSEN			EQU	1	; SSP1CON2
PEN				EQU	2	; SSP1CON2
RCEN			EQU	3	; SSP1CON2
ACKEN			EQU	4	; SSP1CON2
ACKDT			EQU	5	; SSP1CON2
ACKSTAT			EQU	6	; SSP1CON2
GCEN			EQU	7	; SSP1CON2
; =====================================
DHEN			EQU	0	; SSP1CON3
AHEN			EQU	1	; SSP1CON3
SBCDE			EQU	2	; SSP1CON3
SDAHT			EQU	3	; SSP1CON3
BOEN			EQU	4	; SSP1CON3
SCIE			EQU	5	; SSP1CON3
PCIE			EQU	6	; SSP1CON3
ACKTIM			EQU	7	; SSP1CON3
; =====================================
CCP1M0			EQU	0	; CCP1CON
CCP1M1			EQU	1	; CCP1CON
CCP1M2			EQU	2	; CCP1CON
CCP1M3			EQU	3	; CCP1CON
DC1B0			EQU	4	; CCP1CON
DC1B1			EQU	5	; CCP1CON
P1M0			EQU	6	; CCP1CON
P1M1			EQU	7	; CCP1CON
; =====================================
P1DC0			EQU	0	; PWM1CON
P1DC1			EQU	1	; PWM1CON
P1DC2			EQU	2	; PWM1CON
P1DC3			EQU	3	; PWM1CON
P1DC4			EQU	4	; PWM1CON
P1DC5			EQU	5	; PWM1CON
P1DC6			EQU	6	; PWM1CON
P1RSEN			EQU	7	; PWM1CON
; =====================================
PSS1BD0			EQU	0	; CCP1AS
PSS1BD1			EQU	1	; CCP1AS
PSS1AC0			EQU	2	; CCP1AS
PSS1AC1			EQU	3	; CCP1AS
CCP1AS0			EQU	4	; CCP1AS
CCP1AS1			EQU	5	; CCP1AS
CCP1AS2			EQU	6	; CCP1AS
CCP1ASE			EQU	7	; CCP1AS
; =====================================
STR1A			EQU	0	; PSTR1CON
STR1B			EQU	1	; PSTR1CON
STR1C			EQU	2	; PSTR1CON
STR1D			EQU	3	; PSTR1CON
STR1SYNC		EQU	4	; PSTR1CON
; =====================================
IOCAP0			EQU	0	; IOCAP
IOCAP1			EQU	1	; IOCAP
IOCAP2			EQU	2	; IOCAP
IOCAP3			EQU	3	; IOCAP
IOCAP4			EQU	4	; IOCAP
IOCAP5			EQU	5	; IOCAP
; =====================================
IOCAN0			EQU	0	; IOCAN
IOCAN1			EQU	1	; IOCAN
IOCAN2			EQU	2	; IOCAN
IOCAN3			EQU	3	; IOCAN
IOCAN4			EQU	4	; IOCAN
IOCAN5			EQU	5	; IOCAN
; =====================================
IOCAF0			EQU	0	; IOCAF
IOCAF1			EQU	1	; IOCAF
IOCAF2			EQU	2	; IOCAF
IOCAF3			EQU	3	; IOCAF
IOCAF4			EQU	4	; IOCAF
IOCAF5			EQU	5	; IOCAF
; =====================================
CLKRDIV0		EQU	0	; CLKRCON
CLKRDIV1		EQU	1	; CLKRCON
CLKRDIV2		EQU	2	; CLKRCON
CLKRDC0			EQU	3	; CLKRCON
CLKRDC1			EQU	4	; CLKRCON
CLKRSLR			EQU	5	; CLKRCON
CLKROE			EQU	6	; CLKRCON
CLKREN			EQU	7	; CLKRCON
; =====================================
MDBIT			EQU	0	; MDCON
MDOUT			EQU	3	; MDCON
MDOPOL			EQU	4	; MDCON
MDSLR			EQU	5	; MDCON
MDOE			EQU	6	; MDCON
MDEN			EQU	7	; MDCON
; =====================================
MDMS0			EQU	0	; MDSRC
MDMS1			EQU	1	; MDSRC
MDMS2			EQU	2	; MDSRC
MDMS3			EQU	3	; MDSRC
MDMSODIS		EQU	7	; MDSRC
; =====================================
C_SHAD			EQU	0	; STATUS_SHAD
DC_SHAD			EQU	1	; STATUS_SHAD
Z_SHAD			EQU	2	; STATUS_SHAD

; =====================================
;		Configuration Definitions
; =====================================
CONFIG1			EQU	08007h
FOSC_ECH		EQU	0FFFFh
FOSC_ECM		EQU	0FFFEh
FOSC_ECL		EQU	0FFFDh
FOSC_INTOSC		EQU	0FFFCh
FOSC_EXTRC		EQU	0FFFBh
FOSC_HS			EQU	0FFFAh
FOSC_XT			EQU	0FFF9h
FOSC_LP			EQU	0FFF8h
WDTE_ON			EQU	0FFFFh
WDTE_NSLEEP		EQU	0FFF7h
WDTE_SWDTEN		EQU	0FFEFh
WDTE_OFF		EQU	0FFE7h
PWRTE_OFF		EQU	0FFFFh
PWRTE_ON		EQU	0FFDFh
MCLRE_ON		EQU	0FFFFh
MCLRE_OFF		EQU	0FFBFh
CP_OFF			EQU	0FFFFh
CP_ON			EQU	0FF7Fh
CPD_OFF			EQU	0FFFFh
CPD_ON			EQU	0FEFFh
BOREN_ON		EQU	0FFFFh
BOREN_NSLEEP	EQU	0FDFFh
BOREN_SBODEN	EQU	0FBFFh
BOREN_OFF		EQU	0F9FFh
CLKOUTEN_OFF	EQU	0FFFFh
CLKOUTEN_ON		EQU	0F7FFh
IESO_ON			EQU	0FFFFh
IESO_OFF		EQU	0EFFFh
FCMEN_ON		EQU	0FFFFh
FCMEN_OFF		EQU	0DFFFh
; =====================================
CONFIG2			EQU	08008h
WRT_OFF			EQU	0FFFFh
WRT_BOOT		EQU	0FFFEh
WRT_HALF		EQU	0FFFDh
WRT_ALL			EQU	0FFFCh
PLLEN_ON		EQU	0FFFFh
PLLEN_OFF		EQU	0FEFFh
STVREN_ON		EQU	0FFFFh
STVREN_OFF		EQU	0FDFFh
BORV_19			EQU	0FFFFh
BORV_25			EQU	0FBFFh
LVP_ON			EQU	0FFFFh
LVP_OFF			EQU	0DFFFh
